/*
*********************************************************************************************************
*
*   模块名称 : SRAM 接口层
*   文件名称 : bsp_sram_port.c
*   说    明 : 封装底层硬件宏，对外提供统一的读写接口。
*              本文件不包含任何平台相关代码，移植时无需修改。
*
*********************************************************************************************************
*/

#include "bsp_sram_port.h"

/*
*********************************************************************************************************
*   函 数 名: BSP_SRAM_Init
*   功能说明: 初始化 SRAM，调用硬件层完成总线配置
*   形    参: 无
*   返 回 值: 无
*********************************************************************************************************
*/
void BSP_SRAM_Init(void)
{
    BSP_SRAM_HwInit();
}

/*
*********************************************************************************************************
*   函 数 名: BSP_SRAM_WriteByte
*   功能说明: 向指定地址写入 1 字节
*   形    参: addr - 相对于 SRAM 起始的偏移地址（0 ~ SRAM_SIZE-1）
*             data - 要写入的数据
*   返 回 值: 无
*********************************************************************************************************
*/
void BSP_SRAM_WriteByte(uint32_t addr, uint8_t data)
{
    SRAM_WRITE8(addr, data);
}

/*
*********************************************************************************************************
*   函 数 名: BSP_SRAM_ReadByte
*   功能说明: 从指定地址读取 1 字节
*   形    参: addr - 相对于 SRAM 起始的偏移地址
*   返 回 值: 读取到的字节
*********************************************************************************************************
*/
uint8_t BSP_SRAM_ReadByte(uint32_t addr)
{
    return SRAM_READ8(addr);
}

/*
*********************************************************************************************************
*   函 数 名: BSP_SRAM_Write
*   功能说明: 向 SRAM 连续写入 len 个字节
*   形    参: addr - 起始偏移地址
*             buf  - 数据源缓冲区
*             len  - 写入字节数
*   返 回 值: 无
*********************************************************************************************************
*/
void BSP_SRAM_Write(uint32_t addr, const uint8_t *buf, uint32_t len)
{
    while (len--)
    {
        SRAM_WRITE8(addr, *buf);
        addr++;
        buf++;
    }
}

/*
*********************************************************************************************************
*   函 数 名: BSP_SRAM_Read
*   功能说明: 从 SRAM 连续读取 len 个字节
*   形    参: addr - 起始偏移地址
*             buf  - 目标缓冲区
*             len  - 读取字节数
*   返 回 值: 无
*********************************************************************************************************
*/
void BSP_SRAM_Read(uint32_t addr, uint8_t *buf, uint32_t len)
{
    while (len--)
    {
        *buf = SRAM_READ8(addr);
        addr++;
        buf++;
    }
}

/*
*********************************************************************************************************
*   函 数 名: BSP_SRAM_Fill
*   功能说明: 将 SRAM 指定区域填充为固定值（常用于清零）
*   形    参: addr - 起始偏移地址
*             val  - 填充值
*             len  - 字节数
*   返 回 值: 无
*   示    例: BSP_SRAM_Fill(0, 0x00, SRAM_SIZE);  // 全部清零
*********************************************************************************************************
*/
void BSP_SRAM_Fill(uint32_t addr, uint8_t val, uint32_t len)
{
    while (len--)
    {
        SRAM_WRITE8(addr, val);
        addr++;
    }
}

/*
*********************************************************************************************************
*   函 数 名: BSP_SRAM_GetSize
*   功能说明: 返回 SRAM 总容量（字节）
*   返 回 值: 字节数
*********************************************************************************************************
*/
uint32_t BSP_SRAM_GetSize(void)
{
    return SRAM_SIZE;
}

/*
*********************************************************************************************************
*   函 数 名: BSP_SRAM_GetBaseAddr
*   功能说明: 返回 SRAM 在 MCU 地址空间中的映射基地址
*   返 回 值: 基地址
*********************************************************************************************************
*/
uint32_t BSP_SRAM_GetBaseAddr(void)
{
    return SRAM_BASE_ADDR;
}